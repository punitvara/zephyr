## drivers/sensor/apds9960/Kconfig
```kconfig
#
# Copyright (c) 2017 Intel Corporation
#
# SPDX-License-Identifier: Apache-2.0
#

menuconfig APDS9960
	bool "APDS9960 Sensor"
	depends on SENSOR && I2C
	default n
	help
	  Enable driver for APDS9960 sensors.

config  APDS9960_I2C_DEV_NAME
	string "I2C Master"
	depends on APDS9960
	default I2C_SS_0_NAME
	help
	  The device name of the I2C master device to which the APDS9960
	  chip is connected.

config APDS9960_DRV_NAME
	string
	prompt "Driver name"
	default "APDS9960"
	depends on APDS9960
	help
	  Device name with which the APDS9960 is identified.

config APDS9960_THREAD_PRIORITY
	int
	prompt "Thread priority"
	depends on APDS9960
	default 10
	help
	  Priority of thread used to handle the timer and thresold triggers.

choice
        prompt "Trigger mode"
        depends on APDS9960
        default APDS9960_TRIGGER_GLOBAL_THREAD
        help
          Specify the type of triggering to be used by the driver.
          Only available for ambient light sensing mode.

config	APDS9960_TRIGGER_NONE
        bool "No trigger"

config APDS9960_TRIGGER_GLOBAL_THREAD
        bool "Use global thread"
        depends on GPIO
        select APDS9960_TRIGGER

config APDS9960_TRIGGER_OWN_THREAD
        bool "Use own thread"
        depends on GPIO
        select APDS9960_TRIGGER

endchoice

config APDS9960_TRIGGER
        bool
        depends on APDS9960

config APDS9960_GPIO_DEV_NAME
        string
        prompt "GPIO device"
        default "GPIO_0"
        depends on APDS9960 && APDS9960_TRIGGER
        help
          The device name of the GPIO device to which the APDS9960 interrupt
          pin is connected.

config APDS9960_GPIO_PIN_NUM
        int
        prompt "GPIO pin number"
        default 52
        depends on APDS9960 && APDS9960_TRIGGER
        help
          The number of the GPIO pin to which the APDS9960 interrupt pin is
          connected.

config APDS9960_THREAD_PRIORITY
        int
        prompt "Thread priority"
        depends on APDS9960 && APDS9960_TRIGGER_OWN_THREAD
        default 10
        help
          Priority of thread used by the driver to handle interrupts.

config APDS9960_THREAD_STACK_SIZE
        int
        prompt "Thread stack size"
        depends on APDS9960 && APDS9960_TRIGGER_OWN_THREAD
        default 1024
        help
          Stack size of thread used by the driver to handle interrupts.

choice
        prompt "Interrupt persist cycles"
        depends on APDS9960 && APDS9960_TRIGGER
        default APDS9960_INT_PERSIST_1
        help
          Number of consecutive intergration cycles for which the data samples
          need to remain outside the threshold window in order for the interrupt
          to be triggered.

config APDS9960_INT_PERSIST_1
        bool "1"

config APDS9960_INT_PERSIST_4
        bool "4"

config APDS9960_INT_PERSIST_8
        bool "8"

config APDS9960_INT_PERSIST_16
        bool "16"

endchoice
```

## drivers/sensor/bmm150/Kconfig
```kconfig
# Kconfig - BMM150 Geomagnetic sensor configuration options

#
# Copyright (c) 2016 Intel Corporation
#
# Licensed under the Apache License, Version 2.0 (the "License");
# you may not use this file except in compliance with the License.
# You may obtain a copy of the License at
#
#     http://www.apache.org/licenses/LICENSE-2.0
#
# Unless required by applicable law or agreed to in writing, software
# distributed under the License is distributed on an "AS IS" BASIS,
# WITHOUT WARRANTIES OR CONDITIONS OF ANY KIND, either express or implied.
# See the License for the specific language governing permissions and
# limitations under the License.
#

menuconfig BMM150
	bool "BMM150 I2C Geomagnetic Chip"
	depends on SENSOR && I2C
	default n
	help
	  Enable driver for BMM150 I2C-based Geomagnetic sensor.
if BMM150

config BMM150_DEV_NAME
	string "BMM150 device name"
	default "bmm150"

config BMM150_I2C_ADDR
	hex "BMM150 I2C slave address"
	default 0x10
	help
	  Specify the I2C slave address for the BMM150.
	  Possible addresses are 0x10,0x11,0x12,0x13.

config BMM150_I2C_MASTER_DEV_NAME
	string "I2C master where BMM150_MAGN is connected"
	default "I2C_0"
	help
	  Specify the device name of the I2C master device to which BMM150
	  is connected.

choice
	prompt "Default preset"
	default BMM150_PRESET_REGULAR
	help
	  Specify the default preset (x/y oversampling, z oversampling, sampling
	  frequency).

config BMM150_PRESET_LOW_POWER
	bool "Low power (3, 3, 10)"

config BMM150_PRESET_REGULAR
	bool "Regular (9, 15, 10)"

config BMM150_PRESET_ENHANCED_REGULAR
	bool "Enhanced regular (15, 27, 10)"

config BMM150_PRESET_HIGH_ACCURACY
	bool "High accuracy (47, 83, 20)"

endchoice

config BMM150_SAMPLING_RATE_RUNTIME
	bool "Enable dynamic sampling rate"
	depends on BMM150
	default n
	help
	  Enable alteration of sampling rate attribute at runtime.

config BMM150_SAMPLING_REP_XY
	bool "Enable dynamic XY oversampling"
	depends on BMM150
	default n
	help
	  Enable alteration of XY oversampling at runtime.

config BMM150_SAMPLING_REP_Z
	bool "Enable dynamic Z oversampling"
	depends on BMM150
	default n
	help
	  Enable alteration of Z oversampling at runtime.

config BMM150_TRIGGER
	bool "Enable triggers"
	depends on GPIO
	default n
	help
	  Enable triggers for BMM150 Geomagnetic sensor

config BMM150_TRIGGER_THREAD_STACK
	int "Thread stack size"
	depends on BMM150_TRIGGER
	default 1024
	help
	  Specify the internal thread stack size.

config BMM150_TRIGGER_DRDY
	bool "Enable data ready trigger"
	depends on BMM150_TRIGGER
	default n
	help
	  Enable data ready interrupt for BMM150 Geomagnetic

config BMM150_GPIO_DRDY_DEV_NAME
	string "GPIO device where BMM150 data ready interrupt is connected"
	depends on BMM150_TRIGGER_DRDY
	default GPIO_16
	help
	  Specify the device name of the GPIO controller the BMM150 interrupt
	  is connected to.

config BMM150_GPIO_DRDY_INT_PIN
	int
	default 52
	depends on BMM150_TRIGGER_DRDY
	prompt "GPIO pin number for the data ready interrupt pin"
	help
	  GPIO pin number for the data ready interrupt pin.

endif
```

## dts/bindings/iio/adc/intel,qmsi-adc.yaml
```yaml
#
# Copyright (c) 2018 Intel Corporation.
#
# SPDX-License-Identifier: Apache-2.0
#
---
title: Intel D2000 ADC
id: intel,qmsi-adc
version: 0.1

description: >
    This is a representation of the Intel D2000 ADC node

inherits:
    !include adc.yaml

properties:
    compatible:
      type: string
      category: required
      description: compatible strings
      constraint: "intel,qmsi-adc"

    reg:
      type: array
      description: mmio register space
      generation: define
      category: required

    interrupts:
      type: array
      category: required
      description: required interrupts
      generation: define
...
```
