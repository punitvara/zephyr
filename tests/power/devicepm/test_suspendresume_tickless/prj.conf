## prj.conf
```kconfig
CONFIG_ZTEST=y
CONFIG_ZTEST_STACKSIZE=2048
CONFIG_SYS_POWER_MANAGEMENT=y
CONFIG_SYS_POWER_LOW_POWER_STATE=y
CONFIG_TICKLESS_IDLE=y
CONFIG_DEVICE_POWER_MANAGEMENT=y
CONFIG_COUNTER=y
CONFIG_RTC=y
CONFIG_SERIAL=y
CONFIG_UART_INTERRUPT_DRIVEN=y
```

## src/main.c
```c
/*
 * Copyright (c) 2018 Intel Corporation
 *
 * SPDX-License-Identifier: Apache-2.0
 */

#include <ztest.h>
extern void test_suspendresume_sysdevices(void);
extern void test_suspendresume_sysclock(void);
extern void test_suspendresume_rtc(void);
extern void test_suspendresume_uart(void);
extern void test_suspendresume_aonpt(void);
extern int wait_for_test_start(void);

/*test case main entry*/
void test_main(void)
{
	ztest_test_suite(test_suspendresume_tickless,
		ztest_unit_test(test_suspendresume_sysdevices),
		ztest_unit_test(test_suspendresume_sysclock),
		ztest_unit_test(test_suspendresume_rtc),
		ztest_unit_test(test_suspendresume_uart),
		ztest_unit_test(test_suspendresume_aonpt));
	ztest_run_test_suite(test_suspendresume_tickless);
}
```

## src/test_suspendresume_tickless.c
```c
/*
 * Copyright (c) 2018 Intel Corporation
 *
 * SPDX-License-Identifier: Apache-2.0
 */

#include <ztest.h>

/*macros*/

/*external variables*/
extern void test_tickless(void);
extern void (*hook_dev_state)(int);
extern void (*hook_dev_func)(void);

/*local variables*/

/*test cases*/
void test_suspendresume_sysdevices(void)
{
	/*system devices state set in "test_tickless()"*/
	test_tickless();
}

extern void test_sysclock_state(int);
extern void test_sysclock_func(void);
void test_suspendresume_sysclock(void)
{
	hook_dev_state = test_sysclock_state;
	hook_dev_func = test_sysclock_func;
	test_tickless();
}

extern void test_rtc_state(int);
extern void test_rtc_func(void);
void test_suspendresume_rtc(void)
{
	hook_dev_state = test_rtc_state;
	hook_dev_func = test_rtc_func;
	test_tickless();
}

extern void test_uart_state(int);
extern void test_uart_func(void);
void test_suspendresume_uart(void)
{
	hook_dev_state = test_uart_state;
	hook_dev_func = test_uart_func;
	test_tickless();
}

extern void test_aonpt_state(int);
extern void test_aonpt_func(void);
void test_suspendresume_aonpt(void)
{
	hook_dev_state = test_aonpt_state;
	hook_dev_func = test_aonpt_func;
	test_tickless();
}
```
